## boards/shields/tester_xiao_ble/Kconfig.defconfig
```kconfig
if SHIELD_TESTER_XIAO_BLE

config ZMK_KEYBOARD_NAME
    default "ZMK Tester BLE"

config ZMK_BLE
    def_bool y

config SETTINGS
    def_bool y

endif
```

## boards/shields/tester_xiao_ble/Kconfig.shield
```kconfig
config SHIELD_TESTER_XIAO_BLE
    def_bool $(shields_list_contains,tester_xiao_ble)
```
